/*
 * E2P.c
 *
 *  Created on: Oct 19, 2019
 *      Author: DHKim
 */


/**********************************************************************************************************************
* MODULES USED
**********************************************************************************************************************/
#include "E2P.h"
#include "stm32f7xx_hal.h"
#include "../LIB/Dwt_delay.h"

/**********************************************************************************************************************
* DEFINITIONS AND MACROS
**********************************************************************************************************************/
#define AT24C256C_addr      0xA0    // include W bit

/**********************************************************************************************************************
* TYPEDEFS AND STRUCTURES
**********************************************************************************************************************/

/**********************************************************************************************************************
* PROTOTYPES OF FUNCTIONS
**********************************************************************************************************************/

/**********************************************************************************************************************
* DECLARATIONS OF VARIABLES
**********************************************************************************************************************/
extern I2C_HandleTypeDef hi2c1;

/*--------------------------------------------------------------------------*/
/* Name      | E2P_Write                                                    */
/*--------------------------------------------------------------------------*/
int E2P_Write(uint16_t mem_addr, uint8_t* pData, uint16_t size)
{
    HAL_StatusTypeDef result;

    if (size > 64)
    {
        return -1;
    }

    result = HAL_I2C_Mem_Write(&hi2c1, AT24C256C_addr, mem_addr, 2, pData, size, 1000);
    DWT_Delay(100);

    if (result == HAL_OK)
    {
        return 0;
    }
    else
    {
        return -1;
    }
}

/*--------------------------------------------------------------------------*/
/* Name      | E2P_Read                                                    */
/*--------------------------------------------------------------------------*/
int E2P_Read(uint16_t mem_addr, uint8_t* pData, uint16_t size)
{
    HAL_StatusTypeDef result;

    if (size > 64)
    {
        return -1;
    }

    result = HAL_I2C_Mem_Read(&hi2c1, AT24C256C_addr, mem_addr, 2, pData, size, 1000);
    DWT_Delay(10);

    if (result == HAL_OK)
    {
        return 0;
    }
    else
    {
        return -1;
    }
}

